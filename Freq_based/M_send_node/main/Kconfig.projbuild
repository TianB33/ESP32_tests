## Freq_based/M_send_node/main/Kconfig.projbuild
```kconfig
menu "M node configuration"

    config WIFI_SSID
        string "WiFi SSID"
        default "myssid"
        help
            SSID (network name) for the example to connect to.

    config WIFI_PASSWORD
        string "WiFi Password"
        default "mypassword"
        help
            WiFi password (WPA or WPA2) for the example to use.

    config WIFI_CHANNEL
        int "WiFi Channel"
        range 1 13
        default 1
        help
            WiFi channel (network channel) for the example to use.

    config WIFI_MAX_CONN
        int "Maximal STA connections"
        default 4
        help
            Max number of the STA connects to AP.

endmenu
```

## Freq_based/W_recv_node/main/Kconfig.projbuild
```kconfig
menu "W recv node Configuration"

    orsource "$IDF_PATH/examples/common_components/env_caps/$IDF_TARGET/Kconfig.env_caps"
 
    config UART_PORT_NUM
        int "UART port number"
        range 0 1
        default 1
        help
            UART communication port number for the example.
            See UART documentation for available port numbers.

    config UART_BAUD_RATE
        int "UART communication speed"
        range 1200 5000000
        default 115200
        help
            UART communication speed for Modbus example.

    config UART_RXD
        int "UART RXD pin number"
        range ENV_GPIO_RANGE_MIN ENV_GPIO_IN_RANGE_MAX
        default 5
        help
            GPIO number for UART RX pin. See UART documentation for more information
            about available pin numbers for UART.

    config UART_TXD
        int "UART TXD pin number"
        range ENV_GPIO_RANGE_MIN ENV_GPIO_OUT_RANGE_MAX
        default 4
        help
            GPIO number for UART TX pin. See UART documentation for more information
            about available pin numbers for UART.

    config TASK_STACK_SIZE
        int "UART echo example task stack size"
        range 1024 16384
        default 2048
        help
            Defines stack size for UART echo example. Insufficient stack size can cause crash.

endmenu
```

## LED/W_send_node/main/Kconfig.projbuild
```kconfig
menu "W send node Configuration"

    orsource "$IDF_PATH/examples/common_components/env_caps/$IDF_TARGET/Kconfig.env_caps"
 
    config UART_PORT_NUM
        int "UART port number"
        range 0 1
        default 1

    config UART_BAUD_RATE
        int "UART communication speed"
        range 1200 5000000
        default 115200

    config UART_RXD
        int "UART RXD pin number"
        range ENV_GPIO_RANGE_MIN ENV_GPIO_IN_RANGE_MAX
        default 5

    config UART_TXD
        int "UART TXD pin number"
        range ENV_GPIO_RANGE_MIN ENV_GPIO_OUT_RANGE_MAX
        default 4

    config TASK_STACK_SIZE
        int "UART echo example task stack size"
        range 1024 16384
        default 2048

    config WIFI_SSID
        string "WiFi SSID"
        default "myssid"

    config WIFI_PASSWORD
        string "WiFi Password"
        default "mypassword"

    config WIFI_CHANNEL
        int "WiFi Channel"
        range 1 13
        default 1

    config WIFI_MAX_CONN
        int "Maximal STA connections"
        default 4

endmenu
```
